## config/west.yml
```yaml
manifest:
  remotes:
    - name: GoblinDad
      url-base: https://github.com/GoblinDad
  projects:
    - name: zmkdrac
      remote: GoblinDad
      revision: draculad
      import: app/west.yml
  self:
    path: config
```
